/*
 * SPDX-License-Identifier: GPL-3.0-or-later
 *
 * Black/white fast refresh ("MonoFast") for the EPD037A02 / JD7601 panel.
 *
 * Ported from FrameFilm by kirmisaki (kiritro), GPL-3.0-or-later:
 *   https://github.com/kirmisaki/FrameFilm
 *   firmware/frame_film_ark/components/film_hal/src/hal_epd_370.c
 *   (commit d411d93dabe5b56ce0e03dcdaac2c9771a69ce27)
 * Copyright (c) 2026 kiritro. The 799-byte waveform tables mono_clear,
 * mono_fast and full_clear are copied byte-for-byte; the command sequence
 * (epd_spectra_init / _wave / _refresh / _power_off / _full_clear /
 * _prepare / _mono_write / _mono_display) is followed unchanged. HueLeaf
 * changes: the source pixels come from the 4bpp column-major UI frame
 * (ink 0 = black, anything else = white) instead of a 1bpp bitmap, the
 * previous frame is stashed in bit 3 of each nibble instead of a 43 KB
 * m_mono_prev[] buffer (SRAM is full), and a
 * mono_clear cleanup is inserted every CONFIG_HL_MONO_FAST_CLEAN_EVERY frames
 * (FrameFilm itself never does a periodic cleanup).
 *
 * This program is free software: you can redistribute it and/or modify it
 * under the terms of the GNU General Public License as published by the Free
 * Software Foundation, either version 3 of the License, or (at your option)
 * any later version. It is distributed WITHOUT ANY WARRANTY; see LICENSE.
 */
#include <string.h>
#include "driver/gpio.h"
#include "esp_check.h"
#include "esp_log.h"
#include "freertos/FreeRTOS.h"
#include "esp_rom_sys.h"
#include "freertos/task.h"
#include "pin_map.h"
#include "screen_driver.h"
#include "screen_driver_priv.h"
#include "sdkconfig.h"

static const char *TAG = "monofast";

#ifndef CONFIG_HL_MONO_FAST_CLEAN_EVERY
#define CONFIG_HL_MONO_FAST_CLEAN_EVERY 20
#endif

/* FrameFilm geometry: controller rows = 480, 720 px per row. HueLeaf frame
 * bytes are exactly that stream (column-major panel layout). */
#define EPD_WIDTH                 720
#define EPD_HEIGHT                480
#define EPD_INPUT_LINE            (EPD_WIDTH / 2)   /* 360 */
#define EPD_MONO_BATCH_LINES      4
#define EPD_MONO_LINE             (EPD_WIDTH / 8)   /* 90 */
#define EPD_MONO_BYTES            (EPD_WIDTH * EPD_HEIGHT / 8)
_Static_assert(EPD_INPUT_LINE * EPD_HEIGHT == SCREEN_FRAME_BYTES, "layout");

/* Same commands as FrameFilm */
#define SOFT_START                0xE9
#define POF                       0x02
#define PON                       0x04
#define DTM1                      0x10
#define REF                       0x12
#define JD7601_CMD_WAVE_PRE       0x00
#define JD7601_CMD_WRITE_LUT      0x20
#define JD7601_CMD_PLL            0x30
#define JD7601_CMD_UNK_41         0x41
#define JD7601_CMD_TEMP           0xE0
#define JD7601_CMD_UNK_E6         0xE6

#define MONO_CODE_BIT_WHITE       (1)
#define MONO_CODE_INIT_BYTE       ((MONO_CODE_BIT_WHITE) ? 0x00 : 0xFF)
#define BUSY_TIMEOUT_INIT_MS      (15000)
#define BUSY_TIMEOUT_POWER_MS     (60000)
#define BUSY_TIMEOUT_REFRESH_MS   (120000)

/* ---- waveform tables: verbatim from FrameFilm hal_epd_370.c ---- */
static const uint8_t mono_clear[799] = {
    0x00, 0x00, 0x00, 0x00, 0x00, 0x00, 0x00, 0xef, 0xff, 0xff, 0xfc, 0xff, 0xff, 0xef, 0xff, 0xff,
    0xff, 0xff, 0xff, 0xff, 0xff, 0xff, 0xff, 0xff, 0xff, 0xff, 0xff, 0xff, 0xff, 0xff, 0xff, 0xff,
    0xff, 0xff, 0xff, 0xff, 0xff, 0xff, 0xff, 0xff, 0xff, 0xff, 0xff, 0xff, 0xff, 0xff, 0xff, 0xff,
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    0xff, 0xff, 0xff, 0xff, 0xff, 0xff, 0xff, 0xff, 0xff, 0xff, 0xff, 0xff, 0xff, 0xff, 0xff,
};

static const uint8_t mono_fast[799] = {
    0x00, 0x00, 0x00, 0x00, 0x00, 0x00, 0x00, 0xef, 0xff, 0xff, 0xfd, 0xff, 0xff, 0xef, 0xff, 0xff,
    0xff, 0xff, 0xff, 0xff, 0xff, 0xff, 0xff, 0xff, 0xff, 0xff, 0xff, 0xff, 0xff, 0xff, 0xff, 0xff,
    0xff, 0xff, 0xff, 0xff, 0xff, 0xff, 0xff, 0xff, 0xff, 0xff, 0xff, 0xff, 0xff, 0xff, 0xff, 0xff,
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    0xff, 0xff, 0xff, 0xff, 0xff, 0xff, 0xff, 0xff, 0xff, 0xff, 0xff, 0xff, 0xff, 0xff, 0xff,
};

static const uint8_t full_clear[799] = {
    0x00, 0x00, 0x00, 0x00, 0x00, 0x00, 0x00, 0xef, 0xf3, 0xff, 0x7d, 0x7d, 0xff, 0xfd, 0xef, 0xff,
    0xff, 0xef, 0xff, 0xff, 0xff, 0xff, 0xff, 0xff, 0xff, 0xff, 0xff, 0xff, 0xff, 0xff, 0xff, 0xff,
    0xff, 0xff, 0xff, 0xff, 0xff, 0xff, 0xff, 0xff, 0xff, 0xff, 0xff, 0xff, 0xff, 0xff, 0xff, 0xff,
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    0xff, 0xff, 0xff, 0xff, 0xff, 0xff, 0xff, 0xff, 0xff, 0xff, 0xff, 0xff, 0xff, 0xff, 0xff,
};

/* 0 native/stock, 1 cleared, 2 mono (FrameFilm m_spectra_state subset) */
static uint8_t s_state;
static bool s_inited, s_powered;
static unsigned s_since_clean;
/* FrameFilm keeps the previous frame in a 43200-byte m_mono_prev[]; HueLeaf
 * has no SRAM left for that, so the previous code bit of each pixel is
 * stashed in bit 3 of its own nibble in the caller's frame (no ink uses it;
 * frame_set/frame_fill preserve it). s_prev_const >= 0 means "every pixel
 * has this previous code byte" (after full_clear / mono_clear). */
static int s_prev_const = -1;
static uint8_t s_batch[EPD_INPUT_LINE * EPD_MONO_BATCH_LINES];

bool mono_fast_active(void) { return s_inited; }
void mono_fast_forget(void) { s_inited = false; s_powered = false; s_state = 0; s_prev_const = -1; }

void mono_fast_drop_stash(void) { s_state = 0; s_prev_const = -1; }

/* Never 0 ticks: at CONFIG_FREERTOS_HZ=100 pdMS_TO_TICKS(<10) is 0, and a
 * vTaskDelay(0) loop starves IDLE and trips the 30 s task watchdog. */
static void dly(uint32_t ms)
{
    TickType_t t = pdMS_TO_TICKS(ms);
    vTaskDelay(t ? t : 1);
}

static esp_err_t wave(const uint8_t *lut)
{
    ESP_RETURN_ON_ERROR(sd_write_cmd(JD7601_CMD_WAVE_PRE), TAG, "PSR");
    ESP_RETURN_ON_ERROR(sd_write_data_byte(0x0F), TAG, "PSR");
    ESP_RETURN_ON_ERROR(sd_write_data_byte(0xA9), TAG, "PSR");
    ESP_RETURN_ON_ERROR(sd_write_cmd(JD7601_CMD_WRITE_LUT), TAG, "LUT");
    return sd_write_data(lut, 799);
}

static esp_err_t cmd1(uint8_t c, uint8_t d)
{
    ESP_RETURN_ON_ERROR(sd_write_cmd(c), TAG, "cmd");
    return sd_write_data_byte(d);
}

static esp_err_t spectra_init(void)
{
    gpio_set_level(eink_rst, 0); dly(20);
    gpio_set_level(eink_rst, 1); dly(10);
    gpio_set_level(eink_rst, 0); dly(20);
    gpio_set_level(eink_rst, 1); dly(10);
    ESP_RETURN_ON_ERROR(sd_wait_busy(), TAG, "reset busy");
    dly(10);
    ESP_RETURN_ON_ERROR(cmd1(SOFT_START, 0x01), TAG, "E9");
    ESP_RETURN_ON_ERROR(sd_wait_busy(), TAG, "E9 busy");
    ESP_RETURN_ON_ERROR(cmd1(JD7601_CMD_PLL, 0x04), TAG, "30");
    ESP_RETURN_ON_ERROR(cmd1(JD7601_CMD_UNK_41, 0x00), TAG, "41");
    ESP_RETURN_ON_ERROR(cmd1(JD7601_CMD_TEMP, 0x02), TAG, "E0");
    ESP_RETURN_ON_ERROR(cmd1(JD7601_CMD_UNK_E6, 0x19), TAG, "E6");
    s_state = 0;
    s_powered = false;
    return ESP_OK;
}

/* FrameFilm epd_spectra_wait_cycle: BUSY must assert, then release.
 * Unlike FrameFilm, a missing assertion is a FAILURE: the command was not
 * executed as far as we can tell, so the stash no longer describes the panel.
 * Invalidate everything (next MonoFast frame re-inits + full_clear) and let
 * the caller fall back to the stock refresh.
 * Assert phase: tight spin (<= assert_ms, ~1 s, far below the 30 s TWDT) so a
 * short pulse is not missed between 10 ms ticks. Release phase: >= 1 tick
 * sleeps so IDLE runs and the watchdog is fed for the 60/120 s waits. */
static esp_err_t wait_cycle(uint32_t assert_ms, uint32_t release_ms)
{
    TickType_t t = xTaskGetTickCount();
    const TickType_t assert_ticks = pdMS_TO_TICKS(assert_ms) ? pdMS_TO_TICKS(assert_ms) : 1;
    while (sd_busy_level() != 0) {
        if ((TickType_t)(xTaskGetTickCount() - t) > assert_ticks) {
            ESP_LOGE(TAG, "busy never asserted within %ums: invalidating MonoFast state", (unsigned)assert_ms);
            mono_fast_forget();
            return ESP_ERR_INVALID_RESPONSE;
        }
        esp_rom_delay_us(50);
    }
    t = xTaskGetTickCount();
    while (sd_busy_level() == 0) {
        if ((TickType_t)(xTaskGetTickCount() - t) > pdMS_TO_TICKS(release_ms)) {
            ESP_LOGE(TAG, "busy release timeout");
            mono_fast_forget();
            return ESP_ERR_TIMEOUT;
        }
        vTaskDelay(1);
    }
    return ESP_OK;
}

static esp_err_t power_off(void)
{
    if (!s_powered) return ESP_OK;
    ESP_RETURN_ON_ERROR(cmd1(POF, 0x00), TAG, "POF");
    ESP_RETURN_ON_ERROR(wait_cycle(1000, BUSY_TIMEOUT_POWER_MS), TAG, "POF busy");
    dly(20);
    s_powered = false;
    return ESP_OK;
}

static esp_err_t refresh(bool on, bool off)
{
    if (on && !s_powered) {
        ESP_RETURN_ON_ERROR(sd_write_cmd(PON), TAG, "PON");
        ESP_RETURN_ON_ERROR(wait_cycle(1000, BUSY_TIMEOUT_POWER_MS), TAG, "PON busy");
        dly(10);
        s_powered = true;
    }
    ESP_RETURN_ON_ERROR(cmd1(REF, 0x00), TAG, "REF");
    ESP_RETURN_ON_ERROR(wait_cycle(1000, BUSY_TIMEOUT_REFRESH_MS), TAG, "REF busy");
    dly(10);
    return off ? power_off() : ESP_OK;
}

static esp_err_t full_clear_seq(void)
{
    ESP_RETURN_ON_ERROR(wave(full_clear), TAG, "wave");
    memset(s_batch, 0x00, sizeof(s_batch));
    ESP_RETURN_ON_ERROR(sd_write_cmd(DTM1), TAG, "DTM1");
    ESP_RETURN_ON_ERROR(sd_wait_busy(), TAG, "DTM1 busy");
    for (int row = 0; row < EPD_HEIGHT; row += EPD_MONO_BATCH_LINES)
        ESP_RETURN_ON_ERROR(sd_write_data(s_batch, sizeof(s_batch)), TAG, "fill");
    ESP_RETURN_ON_ERROR(refresh(true, true), TAG, "refresh");
    s_prev_const = MONO_CODE_INIT_BYTE;   /* panel is black after clear */
    s_state = 1;
    return ESP_OK;
}

static uint8_t reverse_bits(uint8_t x)
{
    x = (uint8_t)((x >> 4) | (x << 4));
    x = (uint8_t)(((x >> 2) & 0x33) | ((x << 2) & 0xCC));
    return (uint8_t)(((x >> 1) & 0x55) | ((x << 1) & 0xAA));
}

static uint8_t code_byte(uint8_t bitmap_byte)
{
    uint8_t v = reverse_bits(bitmap_byte);
    if (MONO_CODE_BIT_WHITE) v = (uint8_t)~v;
    return v;
}

/* 8 consecutive controller pixels -> FrameFilm 1bpp byte (MSB first, 1 = black) */
static uint8_t bitmap_byte(const uint8_t *f4)
{
    uint8_t b = 0;
    for (int i = 0; i < 4; i++) {
        if (((f4[i] >> 4) & 0x7) == SCREEN_COLOR_BLACK) b |= (uint8_t)(0x80 >> (2 * i));
        if ((f4[i] & 0x7) == SCREEN_COLOR_BLACK) b |= (uint8_t)(0x40 >> (2 * i));
    }
    return b;
}

/* previous code byte for 8 pixels, read from the bit-3 stash */
static uint8_t stash_get(const uint8_t *f4)
{
    uint8_t b = 0;
    for (int i = 0; i < 4; i++) {
        if (f4[i] & 0x80) b |= (uint8_t)(0x80 >> (2 * i));
        if (f4[i] & 0x08) b |= (uint8_t)(0x40 >> (2 * i));
    }
    return reverse_bits(b);   /* same bit order as code_byte(): pixel k -> bit k */
}

static void stash_put(uint8_t *f4, uint8_t code)
{
    for (int i = 0; i < 4; i++) {
        uint8_t v = (uint8_t)(f4[i] & 0x77);
        if (code & (1u << (2 * i))) v |= 0x80;
        if (code & (2u << (2 * i))) v |= 0x08;
        f4[i] = v;
    }
}

/* draw == false: all white (FrameFilm mono_write(NULL)); frame still holds
 * the stash. Afterwards the stash (or s_prev_const) describes the panel. */
static esp_err_t mono_write(uint8_t *frame, bool draw)
{
    ESP_RETURN_ON_ERROR(sd_write_cmd(DTM1), TAG, "DTM1");
    ESP_RETURN_ON_ERROR(sd_wait_busy(), TAG, "DTM1 busy");
    for (int row = 0; row < EPD_HEIGHT; row += EPD_MONO_BATCH_LINES) {
        for (int br = 0; br < EPD_MONO_BATCH_LINES; br++) {
            uint8_t *line = s_batch + br * EPD_INPUT_LINE;
            const int y = row + br;
            uint8_t *src = frame + (size_t)y * EPD_INPUT_LINE;
            for (int x = 0; x < EPD_MONO_LINE; x++) {
                uint8_t old = s_prev_const >= 0 ? (uint8_t)s_prev_const : stash_get(src + 4 * x);
                uint8_t next = code_byte(draw ? bitmap_byte(src + 4 * x) : 0x00);
                if (draw) stash_put(src + 4 * x, next);
                for (int j = 0; j < 4; j++) {
                    line[x * 4 + j] = (uint8_t)(((old << 5) & 0x20) | ((next << 4) & 0x10)
                                                | (old & 2) | ((next >> 1) & 1));
                    old >>= 2;
                    next >>= 2;
                }
            }
        }
        ESP_RETURN_ON_ERROR(sd_write_data(s_batch, sizeof(s_batch)), TAG, "DTM1 data");
    }
    s_prev_const = draw ? -1 : code_byte(0x00);
    return ESP_OK;
}

/* FrameFilm epd_spectra_prepare, state-2 branch (mono -> mono_clear to white) */
static esp_err_t mono_clean(uint8_t *frame)
{
    ESP_RETURN_ON_ERROR(wave(mono_clear), TAG, "wave");
    ESP_RETURN_ON_ERROR(mono_write(frame, false), TAG, "write");
    ESP_RETURN_ON_ERROR(refresh(true, false), TAG, "refresh");
    s_state = 1;
    return ESP_OK;
}

static esp_err_t show_locked(uint8_t *frame)
{
    const TickType_t t0 = xTaskGetTickCount();
    bool first = !s_inited;
    if (!s_inited) {             /* hal_epd_display_mono: init once per session */
        ESP_RETURN_ON_ERROR(spectra_init(), TAG, "init");
        s_inited = true;
    }
    if (s_state != 1 && s_state != 2) {
        ESP_RETURN_ON_ERROR(full_clear_seq(), TAG, "full clear");
        s_since_clean = 0;
    } else if (s_state == 2 && ++s_since_clean >= CONFIG_HL_MONO_FAST_CLEAN_EVERY) {
        ESP_LOGI(TAG, "periodic mono_clear after %u fast frames", s_since_clean);
        ESP_RETURN_ON_ERROR(mono_clean(frame), TAG, "clean");
        s_since_clean = 0;
    }
    ESP_RETURN_ON_ERROR(wave(mono_fast), TAG, "wave");
    ESP_RETURN_ON_ERROR(mono_write(frame, true), TAG, "write");
    ESP_RETURN_ON_ERROR(refresh(true, true), TAG, "refresh");  /* no session: power off */
    s_state = 2;
    ESP_LOGI(TAG, "mono frame %ums%s", (unsigned)((xTaskGetTickCount() - t0) * portTICK_PERIOD_MS),
             first ? " (first, incl. full clear)" : "");
    return ESP_OK;
}

/* Any failure leaves the panel content unknown: drop the stash so the next
 * MonoFast frame starts with spectra_init + full_clear. */
esp_err_t mono_fast_show_locked(uint8_t *frame)
{
    esp_err_t err = show_locked(frame);
    if (err != ESP_OK) mono_fast_forget();
    return err;
}
